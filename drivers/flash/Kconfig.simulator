## drivers/flash/Kconfig.simulator
```kconfig
# Kconfig - Flash simulator config
#
# SPDX-License-Identifier: Apache-2.0

if FLASH_SIMULATOR

config FLASH_SIMULATOR_BASE_ADDR
	hex
	prompt "Base address of the flash"
	default 0x00
	help
	 The base address of the flash.

config FLASH_SIMULATOR_ERASE_UNIT
	int
	prompt "Erase unit size in bytes"
	default 4096
	range 1 65536
	help
	 The smallest area of flash memory that can be indipendently erased.

config FLASH_SIMULATOR_WRITE_UNIT
	int
	prompt "Program unit size in bytes"
	default 4
	range 1 4096
	help
	 The smallest area of flash memory that can be indipendently programmed.

config FLASH_SIMULATOR_FLASH_SIZE
	int
	prompt "Flash size in erase units"
	default 4
	range 1 65536
	help
	 The size of the simulated flash area expressed in erase units.

config FLASH_SIMULATOR_SIMULATE_FAILURES
	bool
	prompt "Enable failure simulation"
	default n
	help
	 This setting enables simulation of various API and hardware failures,
	 which can be used for testing.

config FLASH_SIMULATOR_READ_API_FAILURE_RATE_PM
	int
	prompt "Read API failure rate (‱ per ten thousand)"
	default 0
	range 0 10000
	depends on FLASH_SIMULATOR_SIMULATE_FAILURES
	help
	 This setting controls the read operation failure rate in units of 1/10000 (permyriad).
	 One permyriad is a hundreth of a percent.
	 This setting is intended for testing.

config FLASH_SIMULATOR_READ_HW_FAILURE_RATE_PM
	int
	prompt "Hardware read failure rate ‱ (per ten thousand)"
	default 0
	range 0 10000
	depends on FLASH_SIMULATOR_SIMULATE_FAILURES
	help
	 This setting controls the read operation failure rate in units of 1/10000 (permyriad).
	 One permyriad is a hundreth of a percent.
	 This setting is intended for testing.

config FLASH_SIMULATOR_WRITE_API_FAILURE_RATE_PM
	int
	prompt "Write API failure rate ‱ (per ten thousand)"
	default 0
	range 0 10000
	depends on FLASH_SIMULATOR_SIMULATE_FAILURES
	help
	 This setting controls the write operation failure rate in units of 1/10000 (permyriad).
	 One permyriad is a hundreth of a percent.
	 This setting is intended for testing.

 config FLASH_SIMULATOR_WRITE_HW_FAILURE_RATE_PM
	int
	prompt "Hardware write failure rate ‱ (per ten thousand)"
	default 0
	range 0 10000
	depends on FLASH_SIMULATOR_SIMULATE_FAILURES
	help
	 This setting controls the write operation failure rate in units of 1/10000 (permyriad).
	 One permyriad is a hundreth of a percent.
	 This setting is intended for testing.

config FLASH_SIMULATOR_ERASE_API_FAILURE_RATE_PM
	int
	prompt "Erase API failure rate ‱ (per ten thousand)"
	default 0
	range 0 10000
	depends on FLASH_SIMULATOR_SIMULATE_FAILURES
	help
	 This setting controls the erase operation failure rate in units of 1/10000 (permyriad).
	 One permyriad is a hundreth of a percent.
	 This setting is intended for testing.

	config FLASH_SIMULATOR_ERASE_HW_FAILURE_RATE_PM
	int
	prompt "Hardware erase failure rate ‱ (per ten thousand)"
	default 0
	range 0 10000
	depends on FLASH_SIMULATOR_SIMULATE_FAILURES
	help
	 This setting controls the erase operation failure rate in units of 1/10000 (permyriad).
	 One permyriad is a hundreth of a percent.
	 This setting is intended for testing.

config FLASH_SIMULATOR_SIMULATE_TIMING
	bool
	prompt "Enable hardware timing simulation"
	default n

config FLASH_SIMULATOR_MIN_READ_TIME_US
	int
	prompt "Minimum read time (µS)"
	depends on FLASH_SIMULATOR_SIMULATE_TIMING
	default 2
	range 1 3000000

config FLASH_SIMULATOR_MIN_WRITE_TIME_US
	int
	prompt "Minimum write time (µS)"
	depends on FLASH_SIMULATOR_SIMULATE_TIMING
	default 100
	range 1 3000000

config FLASH_SIMULATOR_MIN_ERASE_TIME_US
	int
	prompt "Minimum erase time (µS)"
	depends on FLASH_SIMULATOR_SIMULATE_TIMING
	default 2000
	range 1 3000000

endif
```
